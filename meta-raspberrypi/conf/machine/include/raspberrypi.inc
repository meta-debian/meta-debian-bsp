## meta-raspberrypi/conf/machine/include/raspberrypi.inc
```bitbake
LINUX_GIT_URI ?= "git://github.com/raspberrypi"
LINUX_GIT_PROTOCOL ?= "https"
LINUX_GIT_PREFIX ?= ""
LINUX_GIT_REPO ?= "linux.git"
LINUX_GIT_SRCREV ?= "rpi-4.14.y"
```

## meta-raspberrypi/conf/machine/raspberrypi.conf
```bitbake
#@TYPE: Machine
#@NAME: RaspberryPi 1 Model B/B+
#@DESCRIPTION: Machine configuration for RaspberryPi 1 Model B/B+ boards
# SoC: Broadcom BCM2835
# CPU: ARM1176JZF-S

require conf/machine/include/raspberrypi.inc

DEFAULTTUNE ?= "arm1176jzfshf"
require conf/machine/include/tune-arm1176jzf-s.inc

IMAGE_FSTYPES ?= "tar.bz2 ext4"

SERIAL_CONSOLES ?= "115200;ttyAMA0"

LINUX_DEFCONFIG ?= "bcmrpi_defconfig"
KERNEL_DEVICETREE ?= " \
	bcm2708-rpi-0-w.dtb \
	bcm2708-rpi-b.dtb \
	bcm2708-rpi-b-plus.dtb \
"
```

## meta-raspberrypi/conf/machine/raspberrypi2.conf
```bitbake
#@TYPE: Machine
#@NAME: RaspberryPi 2 Model B
#@DESCRIPTION: Machine configuration for RaspberryPi 2 Model B
# SoC: Broadcom BCM2836/2837
# CPU: ARM Cortex-A7/A53

require conf/machine/include/raspberrypi.inc

DEFAULTTUNE ?= "cortexa7thf-neon-vfpv4"
require conf/machine/include/tune-cortexa7.inc

IMAGE_FSTYPES ?= "tar.bz2 ext4"

SERIAL_CONSOLES ?= "115200;ttyAMA0"

LINUX_DEFCONFIG ?= "bcm2709_defconfig"
KERNEL_DEVICETREE ?= "bcm2709-rpi-2-b.dtb"
```
